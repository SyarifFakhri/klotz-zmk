#include <behaviors.dtsi>
#include <dt-bindings/zmk/keys.h>
#include <dt-bindings/zmk/bt.h>
#include <dt-bindings/zmk/outputs.h>

#define BASE 0
#define NAV  1
#define RNAV 2
#define CBASE 3
#define SYM  4
#define ADJ  5
#define JMP  6
#define OSL  7
#define NON_BASE_LAYERS layers = <NAV SYM ADJ OSL RNAV>;

#define COMBOMS 20

&lt {
     flavor = "balanced";
};

/ {
    combos {
            // NON ALPHA LAYER
            compatible = "zmk,combos";
            combo_to_base {
                timeout-ms = <COMBOMS>;
                key-positions = <1 2>;
                bindings = <&to BASE>;
                NON_BASE_LAYERS
            };

            compatible = "zmk,combos";
            combo_vim_save {
                timeout-ms = <COMBOMS>;
                key-positions = <2 3>;
                bindings = <&macro_vimsave>;
                NON_BASE_LAYERS
            };

           compatible = "zmk,combos";
           combo_ctrl_alt {
                timeout-ms = <COMBOMS>;
                key-positions = <17 18>;
                bindings
                  = <&macro_sticky_ctrl_alt>;
                NON_BASE_LAYERS
            };
            
            compatible = "zmk,combos";
            combo_ctrl_shift {
                timeout-ms = <COMBOMS>;
                key-positions = <16 17>;
                bindings
                  = <&macro_sticky_ctrl_shift>;
                NON_BASE_LAYERS
            };

            compatible = "zmk,combos";
            combo_shift_alt_ctrl {
                timeout-ms = <COMBOMS>;
                key-positions = <16 17 18>;
                bindings
                  = <&macro_sticky_shift_alt_ctrl>;
                NON_BASE_LAYERS
            };
            
            compatible = "zmk,combos";
            combo_shift_alt {
                timeout-ms = <COMBOMS>;
                key-positions = <16 18>;
                bindings
                  = <&macro_sticky_shift_alt>;
                NON_BASE_LAYERS
            };
                        
            compatible = "zmk,combos";
            combo_ctrl_l {
                timeout-ms = <COMBOMS>;
                key-positions = <12 13>;
                bindings
                  = <&kp LCTRL>;
                NON_BASE_LAYERS
            };

            compatible = "zmk,combos";
            combo_alt_l {
                timeout-ms = <COMBOMS>;
                key-positions = <11 12>;
                bindings
                  = <&kp LALT>;
                NON_BASE_LAYERS
            };

        // BASE
            compatible = "zmk,combos";
            combo_esc {
                timeout-ms = <COMBOMS>;
                key-positions = <1 2>;
                bindings = <&kp ESC>;
                layers = <BASE>;
            };
            
            // GLOBAL
            compatible = "zmk,combos";
            combo_bspc {
                timeout-ms = <COMBOMS>;
                key-positions = <3 4>;
                bindings = <&kp BSPC>;
            };
            
            compatible = "zmk,combos";
            combo_del {
                timeout-ms = <COMBOMS>;
                key-positions = <8 9>;
                bindings = <&kp DEL>;
            };

            compatible = "zmk,combos";
            combo_ret {
                timeout-ms = <COMBOMS>;
                key-positions = <13 14>;
                bindings = <&kp RET>;
            }; 
            
            compatible = "zmk,combos";
            combo_ctrlz {
                timeout-ms = <COMBOMS>;
                key-positions = <20 21>;
                bindings
                  = <&macro_ctrlz>;
            };

            compatible = "zmk,combos";
            combo_ctrlshftz {
                timeout-ms = <COMBOMS>;
                key-positions = <20 21 22>;
                bindings
                  = <&macro_ctrlshftz>;
            };

            compatible = "zmk,combos";
            combo_ctrlx {
                timeout-ms = <COMBOMS>;
                key-positions = <21 22>;
                bindings
                  = <&macro_ctrlx>;
            };

            compatible = "zmk,combos";
            combo_ctrlc {
                timeout-ms = <COMBOMS>;
                key-positions = <22 23>;
                bindings
                  = <&macro_ctrlc>;
            };
            
           compatible = "zmk,combos";
           combo_ctrlv {
                timeout-ms = <COMBOMS>;
                key-positions = <23 24>;
                bindings
                  = <&macro_ctrlv>;
            };
           
            // Mod macros

    };

    macros {
        macro_esc: macro_esc {
            compatible = "zmk,behavior-macro";
            #binding-cells = <0>;
            bindings
                = <&to BASE>
                , <&kp ESC>
                ;
        };        
        
        tabcw: tabcw {
            compatible = "zmk,behavior-macro";
            #binding-cells = <0>;
            bindings
                = <&macro_tap &kp TAB>
                ;
        };
        tabccw: tabccw {
            compatible = "zmk,behavior-macro";
            #binding-cells = <0>;
            bindings
                = <&macro_press &kp LSHFT>
                , <&macro_tap &kp TAB>
                , <&macro_release &kp LSHFT>
                ;
        };
        macro_ctrlz: macro_ctrlz {
            compatible = "zmk,behavior-macro";
            #binding-cells = <0>;
            bindings
                = <&macro_press &kp LCTRL>
                , <&macro_tap &kp Z>
                , <&macro_release &kp LCTRL>
                ;
        };
        macro_ctrlshftz: macro_ctrlshftz {
            compatible = "zmk,behavior-macro";
            #binding-cells = <0>;
            bindings
                = <&macro_press &kp LCTRL>
                , <&macro_press &kp LSHFT>
                , <&macro_tap &kp Z>
                , <&macro_release &kp LCTRL>
                , <&macro_release &kp LSHFT>
                ;
        };
        macro_ctrlx: macro_ctrlx {
            compatible = "zmk,behavior-macro";
            #binding-cells = <0>;
            bindings
                = <&macro_press &kp LCTRL>
                , <&macro_tap &kp X>
                , <&macro_release &kp LCTRL>
                ;
        };
        macro_ctrlc: macro_ctrlc {
            compatible = "zmk,behavior-macro";
            #binding-cells = <0>;
            bindings
                = <&macro_press &kp LCTRL>
                , <&macro_tap &kp C>
                , <&macro_release &kp LCTRL>
                ;
        };
        macro_ctrlv: macro_ctrlv {
            compatible = "zmk,behavior-macro";
            #binding-cells = <0>;
            bindings
                = <&macro_press &kp LCTRL>
                , <&macro_tap &kp V>
                , <&macro_release &kp LCTRL>
                ;
        }; 
        macro_vimsave: macro_vimsave {
            compatible = "zmk,behavior-macro";
            #binding-cells = <0>;
            bindings
                = <&macro_tap &kp COLON>
                , <&macro_tap &kp W>
                , <&macro_tap &kp RET>
                ;
        }; 
         
        macro_sticky_ctrl_alt: macro_sticky_ctrl_alt {
            compatible = "zmk,behavior-macro";
            #binding-cells = <0>;
            bindings
                = <&sk LA(LCTRL)>
                ;
        }; 
    
        macro_sticky_ctrl_shift: macro_sticky_ctrl_shift {
            compatible = "zmk,behavior-macro";
            #binding-cells = <0>;
            bindings
                = <&sk LC(LSHFT)>
                ;
        }; 

        macro_sticky_shift_alt: macro_sticky_shift_alt {
            compatible = "zmk,behavior-macro";
            #binding-cells = <0>;
            bindings
                = <&sk LS(LALT)>
                ;
        }; 
        
        macro_sticky_shift_alt_ctrl: macro_sticky_shift_alt_ctrl {
            compatible = "zmk,behavior-macro";
            #binding-cells = <0>;
            bindings
                = <&sk LC(LA(LSHFT))>
                ;
        };        

        macro_up: macro_up {
            compatible = "zmk,behavior-macro";
            #binding-cells = <0>;
            bindings
                = <&macro_press &kp LCTRL>
                , <&macro_tap &kp U>
                , <&macro_release &kp LCTRL>
                ;
        };
        macro_down: macro_down {
            compatible = "zmk,behavior-macro";
            #binding-cells = <0>;
            bindings
                = <&macro_press &kp LCTRL>
                , <&macro_tap &kp D>
                , <&macro_release &kp LCTRL>
                ;
        };
        
        os_hk: os_hk {
            compatible = "zmk,behavior-macro-one-param";
            #binding-cells = <1>;
            bindings
                = <&macro_press &kp LALT>
                , <&macro_press &kp LGUI>
                , <&macro_press &kp LSHFT>
                , <&macro_param_1to1>
                , <&macro_tap &kp MACRO_PLACEHOLDER>
                , <&macro_release &kp LALT>
                , <&macro_release &kp LGUI>
                , <&macro_release &kp LSHFT>
                ;
        };
        
        m_set: m_set {
            compatible = "zmk,behavior-macro-one-param";
            #binding-cells = <1>;
            bindings
                = <&macro_tap &kp M>
                , <&macro_press &kp LSHFT>
                , <&macro_param_1to1>
                , <&macro_tap &kp MACRO_PLACEHOLDER>
                , <&macro_release &kp LSHFT>
                ;
        };

        m_jmp: m_jmp {
            compatible = "zmk,behavior-macro-one-param";
            #binding-cells = <1>;
            bindings
                = <&macro_tap &kp GRAVE>
                , <&macro_press &kp LSHFT>
                , <&macro_param_1to1>
                , <&macro_tap &kp MACRO_PLACEHOLDER>
                , <&macro_release &kp LSHFT>
                ;
        };

        m_paste: m_paste {
            compatible = "zmk,behavior-macro-one-param";
            #binding-cells = <1>;
            bindings
                = <&macro_tap &kp DQT>
                , <&macro_param_1to1>
                , <&macro_tap &kp MACRO_PLACEHOLDER>
                , <&macro_tap &kp P>
                ;
        };

        m_dkp: m_dkp {
            compatible = "zmk,behavior-macro-two-param";
            #binding-cells = <2>;
            bindings
                = <&macro_param_1to1>
                , <&macro_tap &kp MACRO_PLACEHOLDER>
                , <&macro_param_2to1>
                , <&macro_tap &kp MACRO_PLACEHOLDER>
                ;
        };

        m_b: m_b {
            compatible = "zmk,behavior-macro-one-param";
            #binding-cells = <1>;
            bindings
                = <&to BASE> 
                , <&macro_param_1to1>
                , <&macro_tap &kp MACRO_PLACEHOLDER>
                ;
        };

        kc: kc { // ctrl tap then press control again and then go to homelayer, meant for ctrl + <key> ctrl + <key> chords
            compatible = "zmk,behavior-macro-one-param";
            #binding-cells = <1>;
            bindings
                = <&skq LCTRL>
                , <&macro_param_1to1>
                , <&macro_tap &kp MACRO_PLACEHOLDER>
                , <&skq LCTRL>
                , <&to BASE>
                ;
        };
    };

    behaviors {
        encoder_alt_tab: encoder_alt_tab {
            compatible = "zmk,behavior-sensor-rotate";
            #sensor-binding-cells = <0>;
            bindings = <&tabcw>, <&tabccw>;
        };

        ct: custom_tap {
            compatible = "zmk,behavior-hold-tap";
            #binding-cells = <2>;
            flavor = "balanced";
            bindings = <&kp>, <&kp>;
            tapping-term-ms = <220>;
            quick-tap-ms = <175>;
        };
        
        ctl: custom_tap_layer {
            compatible = "zmk,behavior-hold-tap";
            #binding-cells = <2>;
            flavor = "balanced";
            bindings = <&mo>, <&kp>;
            tapping-term-ms = <220>;
            quick-tap-ms = <175>;
        };

        htl: hold_toggle_layer {
            compatible = "zmk,behavior-hold-tap";
            #binding-cells = <2>;
            flavor = "balanced";
            bindings = <&mo>, <&tog>;
            tapping-term-ms = <220>;
        };
        
        csl: custom_sticky_layer {
            compatible = "zmk,behavior-sticky-key";
            #binding-cells = <1>;
            bindings = <&mo>;
            release-after-ms = <2000>;
            quick-release;
        };

        skq: sticky_key_quick_release {
            compatible = "zmk,behavior-sticky-key";
            #binding-cells = <1>;
            bindings = <&kp>;
            release-after-ms = <2000>;
            quick-release;
            ignore-modifiers;
      };
    };

        keymap {
                compatible = "zmk,keymap";
// ▄▄▄▄▄▄▄▄▄▄▄▄▄▄▄▄▄▄▄▄▄▄▄▄▄▄▄▄▄▄▄▄▄▄▄▄▄▄▄▄▄▄▄▄▄▄▄▄▄▄▄▄▄▄▄▄▄▄▄▄▄▄▄▄▄▄▄▄▄▄▄▄▄▄▄▄▄▄▄▄▄▄▄▄▄▄▄▄▄▄▄▄▄▄▄▄▄▄▄▄▄▄▄▄▄▄▄▄▄▄▄▄▄▄▄▄▄▄▄▄▄▄▄▄▄


                base_layer {
// ┏━━━━━━━━━━━━━━━━━━━━━━━━━━━━━━━━━━━━━━━┓
display-name= "BASE"                              ;
// ┗━━━━━━━━━━━━━━━━━━━━━━━━━━━━━━━━━━━━━━━┛
 bindings = <
// ╷           ╷           ╷           ╷           ╷           ╷   ╷           ╷           ╷           ╷           ╷           ╷

    &kp Q       &kp W       &kp F       &kp P       &kp B           &kp J       &kp L       &kp U       &kp Y       &kp BSPC
    &kp A       &kp R       &kp S       &kp T       &kp G           &kp M       &kp N       &kp E       &kp I       &kp O
    &mo ADJ     &kp COMMA   &kp DOT     &kp D       &kp V           &kp K       &kp H       &kp C       &kp X       &kp Z
                                        &csl NAV    &kp SPACE       &skq RSHFT  &csl SYM
                        >;
            sensor-bindings = <&encoder_alt_tab &inc_dec_kp C_VOL_UP C_VOL_DN>;
                };
// ▄▄▄▄▄▄▄▄▄▄▄▄▄▄▄▄▄▄▄▄▄▄▄▄▄▄▄▄▄▄▄▄▄▄▄▄▄▄▄▄▄▄▄▄▄▄▄▄▄▄▄▄▄▄▄▄▄▄▄▄▄▄▄▄▄▄▄▄▄▄▄▄▄▄▄▄▄▄▄▄▄▄▄▄▄▄▄▄▄▄▄▄▄▄▄▄▄▄▄▄▄▄▄▄▄▄▄▄▄▄▄▄▄▄▄▄▄▄▄▄▄▄▄▄▄


                nav_layer {
// ┏━━━━━━━━━━━━━━━━━━━━━━━━━━━━━━━━━━━━━━━┓
display-name= "NAVI"                              ;
// ┗━━━━━━━━━━━━━━━━━━━━━━━━━━━━━━━━━━━━━━━┛
 bindings = <
// ╷           ╷           ╷           ╷           ╷           ╷   ╷           ╷           ╷           ╷           ╷           ╷

    &kp TAB    &kp N7      &kp N8      &kp N9      &os_hk A        &os_hk F    &kp LEFT   &kp UP      &kp DOWN    &kp RIGHT
    &kp N0     &kp N4      &kp N5      &kp N6      &os_hk B        &os_hk C    &skq RSHFT &skq RCTRL  &skq RALT   &skq LGUI
    &kp ESC    &kp N1      &kp N2      &kp N3      &os_hk C        &os_hk V    &macro_up  &kp RET     &macro_down &to CBASE
                                       &trans      &kp SPACE       &kp LC(O)   &to RNAV
                        >;
            sensor-bindings = <&encoder_alt_tab &inc_dec_kp C_VOL_UP C_VOL_DN>;
                };
// ▄▄▄▄▄▄▄▄▄▄▄▄▄▄▄▄▄▄▄▄▄▄▄▄▄▄▄▄▄▄▄▄▄▄▄▄▄▄▄▄▄▄▄▄▄▄▄▄▄▄▄▄▄▄▄▄▄▄▄▄▄▄▄▄▄▄▄▄▄▄▄▄▄▄▄▄▄▄▄▄▄▄▄▄▄▄▄▄▄▄▄▄▄▄▄▄▄▄▄▄▄▄▄▄▄▄▄▄▄▄▄▄▄▄▄▄▄▄▄▄▄▄▄▄▄


                rnav_layer {
// ┏━━━━━━━━━━━━━━━━━━━━━━━━━━━━━━━━━━━━━━━┓
display-name= "RNAVI"                              ;
// ┗━━━━━━━━━━━━━━━━━━━━━━━━━━━━━━━━━━━━━━━┛
 bindings = <
// ╷           ╷           ╷           ╷           ╷           ╷   ╷           ╷           ╷           ╷           ╷           ╷

    &m_b TAB    &kp N7      &kp N8      &kp N9      &trans         &trans      &m_b LEFT  &m_b UP     &m_b DOWN   &kp BSPC
    &kp N0      &kp N4      &kp N5      &kp N6      &m_b MINUS     &trans      &skq RSHFT &skq RCTRL  &skq RALT   &skq LGUI
    &trans      &kp N1      &kp N2      &kp N3      &m_b KP_MULTIPLY &trans    &macro_up  &kp RET     &macro_down &trans
                                        &trans      &kp SPACE       &skq RSHFT &to BASE
                        >;
            sensor-bindings = <&encoder_alt_tab &inc_dec_kp C_VOL_UP C_VOL_DN>;
                };

// ▄▄▄▄▄▄▄▄▄▄▄▄▄▄▄▄▄▄▄▄▄▄▄▄▄▄▄▄▄▄▄▄▄▄▄▄▄▄▄▄▄▄▄▄▄▄▄▄▄▄▄▄▄▄▄▄▄▄▄▄▄▄▄▄▄▄▄▄▄▄▄▄▄▄▄▄▄▄▄▄▄▄▄▄▄▄▄▄▄▄▄▄▄▄▄▄▄▄▄▄▄▄▄▄▄▄▄▄▄▄▄▄▄▄▄▄▄▄▄▄▄▄▄▄▄

                cbase_layer {
// ┏━━━━━━━━━━━━━━━━━━━━━━━━━━━━━━━━━━━━━━━┓
display-name= "CBASE"                              ;
// ┗━━━━━━━━━━━━━━━━━━━━━━━━━━━━━━━━━━━━━━━┛
 bindings = <
// ╷           ╷           ╷           ╷           ╷           ╷   ╷           ╷           ╷           ╷           ╷           ╷

    &kc Q       &kc W       &kc F       &kc P       &kc B           &kc J       &kc L       &kc U       &kc Y       &trans
    &kc A       &kc R       &kc S       &kc T       &kc G           &kc M       &kc N       &kc E       &kc I       &kc O
    &trans      &kc COMMA   &kc DOT     &kc D       &kc V           &kc K       &kc H       &kc C       &kc X       &kc Z
                                        &csl NAV    &kp SPACE       &skq RSHFT  &csl SYM
                        >;
            sensor-bindings = <&encoder_alt_tab &inc_dec_kp C_VOL_UP C_VOL_DN>;
                };
// ▄▄▄▄▄▄▄▄▄▄▄▄▄▄▄▄▄▄▄▄▄▄▄▄▄▄▄▄▄▄▄▄▄▄▄▄▄▄▄▄▄▄▄▄▄▄▄▄▄▄▄▄▄▄▄▄▄▄▄▄▄▄▄▄▄▄▄▄▄▄▄▄▄▄▄▄▄▄▄▄▄▄▄▄▄▄▄▄▄▄▄▄▄▄▄▄▄▄▄▄▄▄▄▄▄▄▄▄▄▄▄▄▄▄▄▄▄▄▄▄▄▄▄▄▄


                sim_layer {
// ┏━━━━━━━━━━━━━━━━━━━━━━━━━━━━━━━━━━━━━━━┓
display-name= "SYM"                               ;
// ┗━━━━━━━━━━━━━━━━━━━━━━━━━━━━━━━━━━━━━━━┛
 bindings = <
// ╷           ╷           ╷           ╷           ╷           ╷   ╷           ╷           ╷           ╷           ╷           ╷

    &kp PLUS    &kp UNDER   &kp KP_MULTIPLY &kp LBRC &kp RBRC       &kp GRAVE   &kp AMPS    &kp EQUAL   &kp FSLH    &kp COLON
    &kp EXCL    &kp PRCNT   &kp SEMI    &kp LPAR    &kp RPAR        &kp DLLR    &kp BSLH    &kp SQT     &kp DQT     &kp QMARK
    &kp CARET   &kp HASH    &kp AT      &kp LBKT    &kp RBKT        &kp TILDE   &trans      &kp CAPS    &trans      &kp MINUS
                                        &kp PIPE    &trans          &to BASE    &kp LGUI
                        >;
            sensor-bindings = <&encoder_alt_tab &inc_dec_kp C_VOL_UP C_VOL_DN>;
                };

// ▄▄▄▄▄▄▄▄▄▄▄▄▄▄▄▄▄▄▄▄▄▄▄▄▄▄▄▄▄▄▄▄▄▄▄▄▄▄▄▄▄▄▄▄▄▄▄▄▄▄▄▄▄▄▄▄▄▄▄▄▄▄▄▄▄▄▄▄▄▄▄▄▄▄▄▄▄▄▄▄▄▄▄▄▄▄▄▄▄▄▄▄▄▄▄▄▄▄▄▄▄▄▄▄▄▄▄▄▄▄▄▄▄▄▄▄▄▄▄▄▄▄▄▄▄


                adjust_layer {
// ┏━━━━━━━━━━━━━━━━━━━━━━━━━━━━━━━━━━━━━━━┓
display-name= "ADJ"                               ;
// ┗━━━━━━━━━━━━━━━━━━━━━━━━━━━━━━━━━━━━━━━┛
 bindings = <
// ╷           ╷           ╷           ╷           ╷           ╷   ╷           ╷           ╷           ╷           ╷           ╷

    &sys_reset  &bt BT_CLR &kp LCTRL    &kp LSHFT   &bt BT_SEL 1    &trans      &kp F7      &kp F8      &kp F9      &kp F12
    &bootloader &bt BT_NXT &out OUT_BLE &trans      &bt BT_SEL 2    &trans      &kp F4      &kp F5      &kp F6      &kp F11  
    &trans      &bt BT_PRV &out OUT_USB &trans      &bt BT_SEL 3    &trans      &kp F1      &kp F2      &kp F3      &kp F10     
                                        &bt BT_SEL 0 &skq LALT      &skq LCTRL  &skq RSHFT   
                        >;
            sensor-bindings = <&encoder_alt_tab &inc_dec_kp C_VOL_UP C_VOL_DN>;
                };
                
// ▄▄▄▄▄▄▄▄▄▄▄▄▄▄▄▄▄▄▄▄▄▄▄▄▄▄▄▄▄▄▄▄▄▄▄▄▄▄▄▄▄▄▄▄▄▄▄▄▄▄▄▄▄▄▄▄▄▄▄▄▄▄▄▄▄▄▄▄▄▄▄▄▄▄▄▄▄▄▄▄▄▄▄▄▄▄▄▄▄▄▄▄▄▄▄▄▄▄▄▄▄▄▄▄▄▄▄▄▄▄▄▄▄▄▄▄▄▄▄▄▄▄▄▄▄


                jump_layer {
// ┏━━━━━━━━━━━━━━━━━━━━━━━━━━━━━━━━━━━━━━━┓
display-name= "JMP"                              ;
// ┗━━━━━━━━━━━━━━━━━━━━━━━━━━━━━━━━━━━━━━━┛
 bindings = <
// ╷           ╷           ╷           ╷           ╷           ╷   ╷           ╷           ╷           ╷           ╷           ╷

    &m_set A    &m_jmp A    &trans      &m_paste N0 &trans          &trans      &trans      &trans      &trans      &trans
    &m_set B    &m_jmp B    &trans      &trans      &trans          &trans      &trans      &trans      &m_dkp O I  &trans
    &m_set C    &m_jmp C    &trans      &trans      &trans          &trans      &trans      &trans      &trans      &trans
                                        &trans      &trans          &trans      &trans
                        >;
            sensor-bindings = <&encoder_alt_tab &inc_dec_kp C_VOL_UP C_VOL_DN>;
                };

// ▄▄▄▄▄▄▄▄▄▄▄▄▄▄▄▄▄▄▄▄▄▄▄▄▄▄▄▄▄▄▄▄▄▄▄▄▄▄▄▄▄▄▄▄▄▄▄▄▄▄▄▄▄▄▄▄▄▄▄▄▄▄▄▄▄▄▄▄▄▄▄▄▄▄▄▄▄▄▄▄▄▄▄▄▄▄▄▄▄▄▄▄▄▄▄▄▄▄▄▄▄▄▄▄▄▄▄▄▄▄▄▄▄▄▄▄▄▄▄▄▄▄▄▄▄


                os_layer {
// ┏━━━━━━━━━━━━━━━━━━━━━━━━━━━━━━━━━━━━━━━┓
display-name= "OS"                              ;
// ┗━━━━━━━━━━━━━━━━━━━━━━━━━━━━━━━━━━━━━━━┛
 bindings = <
// ╷           ╷           ╷           ╷           ╷           ╷   ╷           ╷           ╷           ╷           ╷           ╷

    &kp LA(F4)  &trans      &os_hk T    &os_hk H    &trans          &trans      &trans      &trans      &trans      &trans
    &os_hk A    &os_hk V    &os_hk C    &os_hk F    &trans          &trans      &trans      &trans      &trans      &trans
    &trans      &os_hk E    &trans      &trans      &trans          &trans      &trans      &trans      &trans      &trans
                                        &trans      &trans          &trans      &trans
                        >;
            sensor-bindings = <&encoder_alt_tab &inc_dec_kp C_VOL_UP C_VOL_DN>;
                };
        };
};